## target/custom/Config.in
```kconfig
#


config CUSTOM_GIT_LOCALMIRROR
        string
        prompt "Local git repository for custom source" if CUSTOM_OPTIONS
        default "ssh://some.repository" 
```
